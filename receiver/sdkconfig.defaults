## receiver/sdkconfig.defaults
```kconfig
CONFIG_ESP_CONSOLE_UART_CUSTOM=y
CONFIG_ESP_WIFI_CSI_ENABLED=y
CONFIG_ESP_CONSOLE_UART_BAUDRATE=921600
CONFIG_ESPTOOLPY_FLASHSIZE_4MB=y
```

## sender/sdkconfig.defaults
```kconfig
CONFIG_ESP_CONSOLE_UART_CUSTOM=y
CONFIG_ESP_CONSOLE_UART_BAUDRATE=921600
CONFIG_FREERTOS_HZ=1000
CONFIG_ESPTOOLPY_FLASHSIZE_4MB=y
```
